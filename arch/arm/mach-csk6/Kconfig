## arch/arm/mach-csk6/Kconfig
```kconfig
if ARCH_CSK6

config CSK6011A
	bool "csk6011a family"
	select CLK
	select DM_GPIO
	select DM_RESET
	select MISC
	select PINCTRL
	# select PINCTRL_CSK6
	select RAM
	# select CSK6_RCC
	# select CSK6_PSRAM
	# select CSK6_SERIAL
	# select CSK6_TIMER
	select SYS_ARCH_TIMER

source "arch/arm/mach-csk6/csk6011a/Kconfig"


endif
```

## arch/arm/mach-csk6/csk6011a/Kconfig
```kconfig
if CSK6011A

config TARGET_CSK6011A_NANO
	bool "ListenAI csk6011a-nano-board"

source "board/listenai/csk6011a-nano/Kconfig"

endif
```

## board/listenai/csk6011a-nano/Kconfig
```kconfig
if TARGET_CSK6011A_NANO

config SYS_BOARD
	string
	default "csk6011a-nano"

config SYS_VENDOR
	string
	default "listenai"

config SYS_SOC
	string
	default "csk6011a"

config SYS_CONFIG_NAME
	string
	default "csk6011a-nano"

endif
```

## configs/csk6011a-nano_defconfig
```kconfig
CONFIG_ARM=y
CONFIG_ARCH_CSK6=y
CONFIG_TEXT_BASE=0x18000000
CONFIG_SYS_MALLOC_LEN=10240
CONFIG_NR_DRAM_BANKS=1
CONFIG_ENV_SIZE=0x2000
CONFIG_ENV_SECT_SIZE=0x20000
CONFIG_DEFAULT_DEVICE_TREE="csk6011a-nano"
CONFIG_CSK6011A=y
CONFIG_TARGET_CSK6011A_NANO=y
CONFIG_SYS_LOAD_ADDR=0x18101000

CONFIG_BOOTDELAY=3
CONFIG_USE_BOOTARGS=y
CONFIG_BOOTARGS="console=ttyS0,115200 earlyprintk consoleblank=0 ignore_loglevel"
CONFIG_MISC_INIT_R=y
CONFIG_HUSH_PARSER=y
CONFIG_SYS_PROMPT="U-Boot > "
CONFIG_SYS_PBSIZE=1050
CONFIG_CMD_IMLS=n
CONFIG_CMD_TIMER=n
CONFIG_OF_CONTROL=y

CONFIG_SYS_CONFIG_NAME="csk6011a-nano"

CONFIG_DM=n
CONFIG_CMD_DM=n
CONFIG_CMD_FLASH=n

CONFIG_SYS_NS16550=y
CONFIG_SYS_NS16550_REG_SIZE=-4
CONFIG_SYS_NS16550_MEM32=y
CONFIG_SYS_LITTLE_ENDIAN=y

CONFIG_DM_SERIAL=y
CONFIG_USE_BOOTCOMMAND=y
CONFIG_BOOTCOMMAND="bootzp 18101000"
CONFIG_BOOTDELAY=3

CONFIG_SPI=y
CONFIG_DM_SPI=y
CONFIG_DM_SPI_FLASH=y

CONFIG_ATCSPI200_SPI=y
CONFIG_MTD=y

CONFIG_BOOTDEV_SPI_FLASH=n

CONFIG_SPI_FLASH_ATMEL=y
CONFIG_SPI_FLASH_EON=y
CONFIG_SPI_FLASH_GIGADEVICE=y
CONFIG_SPI_FLASH_MACRONIX=y
CONFIG_SPI_FLASH_SPANSION=y
CONFIG_SPI_FLASH_STMICRO=y
CONFIG_SPI_FLASH_SST=y
CONFIG_SPI_FLASH_WINBOND=y

CONFIG_CMD_SAVEENV=y
CONFIG_ENV_IS_IN_FLASH=y
CONFIG_ENV_ADDR=0x18004000
CONFIG_ENV_VARS_UBOOT_CONFIG=y

# CONFIG_CMD_FLASH=y


# CONFIG_USE_SYS_MAX_FLASH_SECT=y
# CONFIG_SYS_MAX_FLASH_BANKS_DETECT=y
# # CONFIG_SPI_FLASH_MTD=y
# CONFIG_MTD_NOR_FLASH=y

# # CONFIG_SYS_FLASH_CFI=y
# CONFIG_CFI_FLASH=y
# CONFIG_FLASH_CFI_DRIVER=y

# # CONFIG_SYS_FLASH_USE_BUFFER_WRITE=y
```
